## Lorawan/Kconfig
```kconfig
# COPYRIGHT 2022 CONNECTED DEVELOPMENT, A DIVISION OF
# EXPONENTIAL TECHNOLOGY GROUP.
#
# SPDX-License-Identifier: Apache-2.0

# If many DBG logs are enabled, override the default log buffer size.
# This must be done before the original default value is defined in Kconfig.zephyr.
config LOG_BUFFER_SIZE
   int
   default 10240 if LBM_LOG_LEVEL_DBG || SPI_LOG_LEVEL_DBG || LBM_HAL_DBG_DEEP

source "Kconfig.zephyr"

menu "LoRa Basics Modem Options"
   rsource "../LoRaBasicsModem_SWL2001/Kconfig"
endmenu
```
